/dts-v1/;
#include <nordic/nrf9151_laca.dtsi>
#include "loouq_mtc2_n9151-common.dtsi"
#include "loouq_mtc2_n9151-pinctrl.dtsi"
#include "loouq_mtc2_n9151-partitioning.dtsi"

/ {
	chosen {
		zephyr,sram = &sram0_s;
		zephyr,flash = &flash0;
		zephyr,code-partition = &slot0_partition;
		zephyr,sram-secure-partition = &sram0_s;
		zephyr,sram-non-secure-partition = &sram0_ns;
	};
};
