## LooUQ/loouq_mtc2_n9151/Kconfig.loouq_mtc2_n9151
```kconfig
# LooUQ MTC.2-N9151 nRF9151 board configuration

# Copyright (c) 2023 Nordic Semiconductor ASA
# SPDX-License-Identifier: Apache-2.0

# Copyright (c) 2025 LooUQ Incorported

config BOARD_LOOUQ_MTC2_N9151
	select SOC_NRF9151_LACA
```

## LooUQ/loouq_mtc2_n9151/board.yml
```yaml
board:
  name: loouq_mtc2_n9151
  full_name: LooUQ MTC2-N9151 
  vendor: loouq
  socs:
  - name: nrf9151
    variants:
    - name: ns
```
